## yocto-5.0.20/build/conf/bblayers.conf
```bitbake
# POKY_BBLAYERS_CONF_VERSION is increased each time build/conf/bblayers.conf
# changes incompatibly
POKY_BBLAYERS_CONF_VERSION = "2"

BBPATH = "${TOPDIR}"
BBFILES ?= ""

BBLAYERS ?= " \
  /workspaces/yoctoprojectarabic/yocto-5.0.20/poky/meta \
  /workspaces/yoctoprojectarabic/yocto-5.0.20/poky/meta-poky \
  /workspaces/yoctoprojectarabic/yocto-5.0.20/poky/meta-yocto-bsp \
  /workspaces/yoctoprojectarabic/yocto-5.0.20/meta-openjdk-temurin \
  /workspaces/yoctoprojectarabic/yocto-5.0.20/meta-java17-image \
  "
```

## yocto-5.0.20/meta-java17-image/conf/layer.conf
```bitbake
BBPATH .= ":${LAYERDIR}"

BBFILES += "${LAYERDIR}/recipes-*/*/*.bb \
            ${LAYERDIR}/recipes-*/*/*.bbappend"

BBFILE_COLLECTIONS += "meta-java17-image"
BBFILE_PATTERN_meta-java17-image = "^${LAYERDIR}/"
BBFILE_PRIORITY_meta-java17-image = "7"

LAYERDEPENDS_meta-java17-image = "core meta-openjdk-temurin"
LAYERSERIES_COMPAT_meta-java17-image = "scarthgap"
```
